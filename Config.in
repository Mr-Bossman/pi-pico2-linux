## board/raspberrypi/raspberrypi-pico2/raspberrypi-pico2_defconfig
```kconfig
CONFIG_LOG_BUF_SHIFT=15
CONFIG_BLK_DEV_INITRD=y
CONFIG_INITRAMFS_SOURCE="${BR_BINARIES_DIR}/rootfs.cpio"
CONFIG_CC_OPTIMIZE_FOR_SIZE=y
CONFIG_EXPERT=y
# CONFIG_FHANDLE is not set
CONFIG_BASE_SMALL=y
# CONFIG_EPOLL is not set
# CONFIG_SIGNALFD is not set
# CONFIG_TIMERFD is not set
# CONFIG_EVENTFD is not set
# CONFIG_AIO is not set
# CONFIG_IO_URING is not set
# CONFIG_ADVISE_SYSCALLS is not set
# CONFIG_KALLSYMS is not set
# CONFIG_MMU is not set
CONFIG_ARCH_VIRT=y
CONFIG_NONPORTABLE=y
CONFIG_ARCH_RV32I=y
CONFIG_CMODEL_MEDANY=y
# CONFIG_RISCV_ISA_C is not set
# CONFIG_RISCV_ISA_ZBB is not set
# CONFIG_FPU is not set
# CONFIG_RISCV_ISA_VENDOR_EXT_ANDES is not set
# CONFIG_RISCV_ISA_VENDOR_EXT_THEAD is not set
CONFIG_CMDLINE="earlycon=pl011,mmio32,0x40070000 console=ttyAMA0"
CONFIG_PHYS_RAM_BASE_FIXED=y
CONFIG_PHYS_RAM_BASE=0x11000000
# CONFIG_SUSPEND is not set
CONFIG_JUMP_LABEL=y
# CONFIG_COMPAT_32BIT_TIME is not set
# CONFIG_GCC_PLUGINS is not set
# CONFIG_BLOCK is not set
# CONFIG_BINFMT_ELF_FDPIC is not set
CONFIG_BINFMT_FLAT=y
# CONFIG_COREDUMP is not set
CONFIG_SLUB_TINY=y
# CONFIG_COMPAT_BRK is not set
# CONFIG_VM_EVENT_COUNTERS is not set
CONFIG_DEVTMPFS=y
CONFIG_DEVTMPFS_MOUNT=y
# CONFIG_FW_LOADER is not set
# CONFIG_ALLOW_DEV_COREDUMP is not set
# CONFIG_INPUT_KEYBOARD is not set
# CONFIG_INPUT_MOUSE is not set
# CONFIG_SERIO is not set
# CONFIG_LEGACY_PTYS is not set
# CONFIG_LDISC_AUTOLOAD is not set
CONFIG_SERIAL_8250=y
# CONFIG_SERIAL_8250_DEPRECATED_OPTIONS is not set
CONFIG_SERIAL_8250_CONSOLE=y
CONFIG_SERIAL_8250_NR_UARTS=1
CONFIG_SERIAL_8250_RUNTIME_UARTS=1
CONFIG_SERIAL_OF_PLATFORM=y
CONFIG_SERIAL_AMBA_PL011=y
CONFIG_SERIAL_AMBA_PL011_CONSOLE=y
# CONFIG_HW_RANDOM is not set
# CONFIG_DEVMEM is not set
# CONFIG_HWMON is not set
# CONFIG_HID_SUPPORT is not set
# CONFIG_USB_SUPPORT is not set
# CONFIG_VIRTIO_MENU is not set
# CONFIG_VHOST_MENU is not set
CONFIG_SIMPLE_INTC=y
# CONFIG_DNOTIFY is not set
# CONFIG_INOTIFY_USER is not set
# CONFIG_MISC_FILESYSTEMS is not set
CONFIG_LSM="[]"
# CONFIG_CRC_OPTIMIZATIONS is not set
CONFIG_PRINTK_TIME=y
# CONFIG_DEBUG_BUGVERBOSE is not set
# CONFIG_DEBUG_MISC is not set
CONFIG_FRAME_WARN=2048
CONFIG_STRIP_ASM_SYMS=y
# CONFIG_FRAME_POINTER is not set
# CONFIG_FTRACE is not set
# CONFIG_RUNTIME_KERNEL_TESTING_MENU is not set
# CONFIG_RUNTIME_TESTING_MENU is not set
```

## configs/raspberrypi-pico2_defconfig
```kconfig
# Architecture
BR2_riscv=y
BR2_riscv_custom=y
BR2_RISCV_ISA_RVM=y
BR2_RISCV_ISA_RVC=y
BR2_RISCV_32=y
# BR2_RISCV_USE_MMU is not set

# System
BR2_GLOBAL_PATCH_DIR="$(BR2_EXTERNAL)/board/raspberrypi/raspberrypi-pico2/patches"
BR2_PTHREADS_NONE=y
BR2_OPTIMIZE_S=y

# Filesystem
BR2_TARGET_ROOTFS_INITRAMFS=y
BR2_ROOTFS_OVERLAY="$(BR2_EXTERNAL)/board/raspberrypi/raspberrypi-pico2/rootfs_overlay"

# Busybox
BR2_PACKAGE_BUSYBOX_CONFIG="$(BR2_EXTERNAL)/board/raspberrypi/raspberrypi-pico2/busybox.config"

# Image
BR2_ROOTFS_POST_IMAGE_SCRIPT="support/scripts/genimage.sh"
BR2_ROOTFS_POST_BUILD_SCRIPT="$(BR2_EXTERNAL)/board/raspberrypi/raspberrypi-pico2/post-build.sh"
BR2_ROOTFS_POST_SCRIPT_ARGS="-c $(BR2_EXTERNAL)/board/raspberrypi/raspberrypi-pico2/genimage.cfg"

# Linux headers same as kernel
BR2_PACKAGE_HOST_LINUX_HEADERS_CUSTOM_6_15=y

# Kernel
BR2_LINUX_KERNEL=y
BR2_LINUX_KERNEL_CUSTOM_VERSION=y
BR2_LINUX_KERNEL_CUSTOM_VERSION_VALUE="6.15"
BR2_LINUX_KERNEL_USE_CUSTOM_CONFIG=y
BR2_LINUX_KERNEL_CUSTOM_CONFIG_FILE="$(BR2_EXTERNAL)/board/raspberrypi/raspberrypi-pico2/raspberrypi-pico2_defconfig"
BR2_LINUX_KERNEL_DTS_SUPPORT=y
BR2_LINUX_KERNEL_CUSTOM_DTS_DIR="$(BR2_EXTERNAL)/board/raspberrypi/raspberrypi-pico2/dts/"

# Host tools
BR2_PACKAGE_HOST_GENIMAGE=y
```

## package/Config.in
```kconfig
source "$BR2_EXTERNAL_RPI_PICO2_PATH/package/psram-bootloader/Config.in"
source "$BR2_EXTERNAL_RPI_PICO2_PATH/package/libusb/Config.in.host"
source "$BR2_EXTERNAL_RPI_PICO2_PATH/package/pico-sdk2/Config.in"
source "$BR2_EXTERNAL_RPI_PICO2_PATH/package/pico-sdk2/Config.in.host"
source "$BR2_EXTERNAL_RPI_PICO2_PATH/package/picotool2/Config.in"
source "$BR2_EXTERNAL_RPI_PICO2_PATH/package/picotool2/Config.in.host"
source "$BR2_EXTERNAL_RPI_PICO2_PATH/package/newlib/Config.in"
```

## package/libusb/Config.in.host
```kconfig
config BR2_PACKAGE_HOST_LIBUSB
	bool "host libusb"
	depends on BR2_HOST_GCC_AT_LEAST_4_9 # _Thread_local
	help
	  Userspace library for accessing USB devices

	  http://libusb.info/

comment "host libusb needs a toolchain w/ threads, host gcc >= 4.9"
	depends on !BR2_HOST_GCC_AT_LEAST_4_9
```

## package/pico-sdk2/Config.in.host
```kconfig
config BR2_PACKAGE_HOST_PICO_SDK2
	bool "host pico-sdk2"
	help
	  Raspberry Pi Pico SDK. Provides the headers, libraries
	  and build system necessary to write programs for the
	  RP2040-based devices such as the Raspberry Pi Pico in
	  C, C++ or assembly language.

	  https://github.com/raspberrypi/pico-sdk
```

## package/pico2-bootloader/Config.in
```kconfig
config BR2_PACKAGE_PICO2_BOOTLOADER
	bool "raspberry pi pico 2 bootloader"
	help
		Custom bootloader for raspberry pi pico 2
		to load linux.
```

## package/psram-bootloader/Config.in
```kconfig
comment "psram-bootloader needs a toolchain w/ C++"
	depends on !BR2_INSTALL_LIBSTDCPP

config BR2_PACKAGE_PSRAM_BOOTLOADER
	bool "psram-bootloader"
	depends on BR2_LINUX_KERNEL
	depends on BR2_LINUX_KERNEL_IMAGE
	depends on BR2_INSTALL_LIBSTDCPP
	select BR2_PACKAGE_NEWLIB
	select BR2_PACKAGE_HOST_CMAKE
	select BR2_PACKAGE_PICO_SDK2
	help
	  psram-bootloader boot linux on Raspberry Pi Pico 2
	  from PSRAM.
```
